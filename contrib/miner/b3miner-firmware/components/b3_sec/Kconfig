## contrib/miner/b3miner-firmware/components/b3_sec/Kconfig
```kconfig
menu "B3 secure element"

    config B3_SEC_REQUIRE_PROVISIONED
        bool "Refuse to mine when the ATECC608B is missing or unlocked"
        default n
        help
            Off: log the chip state and keep mining.
            On: skip Stratum and FPGA work and show
            "Card unprovisioned — run factory fixture".

endmenu
```

## contrib/miner/b3miner-firmware/main/Kconfig.projbuild
```kconfig
menu "B3Miner firmware"

    config B3_DEVICE_NAME
        string "Default mDNS / hostname prefix"
        default "b3miner"

    config B3_FPGA_SIM
        bool "Use simulated FPGA backend (no KU5P required)"
        default n
        help
            Replaces the SPI-driven FPGA driver with an in-memory
            simulator that returns synthetic shares at a fixed rate.
            Use to bring up Stratum/Ethernet on an ESP32-S3 devkit
            before KU5P silicon is available.

    config B3_FPGA_SIM_KHS
        int "Simulated hashrate (kH/s)"
        depends on B3_FPGA_SIM
        range 1 100000
        default 20000

    config B3_FPGA_SIM_SHARE_INTERVAL_MS
        int "Time between simulated shares (ms)"
        depends on B3_FPGA_SIM
        range 100 600000
        default 100

    config B3_FPGA_SPI_HOST
        int "SPI host (SPI2_HOST=1, SPI3_HOST=2)"
        range 1 2
        default 2

    config B3_FPGA_SPI_MHZ
        int "SPI clock MHz to FPGA"
        range 1 5
        default 5

    config B3_FPGA_CONFIG_JTAG_ONLY
        bool "FPGA is configured externally over JTAG"
        default y
        help
            The XCKU5P-2FFVB676 PCB does not wire ESP32 GPIOs to
            PROGRAM_B/INIT_B/DONE. Keep this enabled unless a board
            revision provides a reviewed configuration interface.

    config B3_FPGA_BOOT_SELFTEST
        bool "Run nonce 0/1 B3PoW parity test at boot"
        depends on !B3_FPGA_SIM
        default y

    config B3_NETWORK_WIFI
        bool
        default y

    config B3_WIFI_SSID
        string "Wi-Fi SSID"
        depends on B3_NETWORK_WIFI
        default ""

    config B3_WIFI_PASSWORD
        string "Wi-Fi password"
        depends on B3_NETWORK_WIFI
        default ""

    config B3_STRATUM_DEFAULT_URL
        string "Default pool URL (stratum+tcp://...)"
        default "stratum+tcp://pool.b3chain.org:3333"

    config B3_STRATUM_DEFAULT_USER
        string "Default worker user (email.worker)"
        default "miner@example.com.rig1"

    config B3_STRATUM_DEFAULT_PASS
        string "Default worker password"
        default "x"

    config B3_STRATUM_DEFAULT_DIFF
        int "Assumed share difficulty until set_difficulty"
        default 65536

    config B3_OTA_UPDATE_URL
        string "HTTPS manifest URL for OTA (empty = disabled)"
        default ""

    config B3_WEB_HTTP_PORT
        int "Local dashboard HTTP port"
        default 80

endmenu
```
